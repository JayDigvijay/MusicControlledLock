
//Audio Controlled lock V2.0 for A.R.C inductions by Digvijay Singh, 2017AAPS0317H
void setup() {
  // put your setup code here, to run once:
 Serial.begin(9600);
 pinMode(5, INPUT);
 pinMode(A3,INPUT);
}
 
void loop() {
  int i,c,value,k, item, a[300],r=0,d[600];
   int b[] = {1,1,0,0,0,1,0,0,1,1,0,0,0,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0,0};
  item = digitalRead(5);
   if(item == HIGH)
   
   {
    for(i=0,c=0,k=0;i<300;i++)
    {
      a[i] = digitalRead(5);
      if(a[i] == 1)
        k++;
      if(r>0)
      {
        if(a[i] == d[i])
         c++;
      }
      else
      {
      if(a[i]==b[i])
         c++;
      }
      
      Serial.println(c);
    }
      Serial.println(k);
     if(c>260&&k>0&&k<15)
   {
    Serial.println("Lock Opened");
   
   }
   else
    Serial.println("Wrong tune, try again");
   
   }
  }
